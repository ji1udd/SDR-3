//
//  Rx/Tx-Meter for SDR-3
//
//  This program is free software; you can redistribute it and/or modify
//  it under the terms of the GNU General Public License as published by
//  the Free Software Foundation; either version 2 of the License, or
//  (at your option) any later version.
//
//  This program is distributed in the hope that it will be useful,
//  but WITHOUT ANY WARRANTY; without even the implied warranty of
//  MERCHANTABILITY or FITNESS FOR A PARTICULAR PURPOSE.  See the
//  GNU General Public License for more details.
//
//  You should have received a copy of the GNU General Public License
//  along with this program; if not, write to the Free Software
//  Foundation, Inc., 59 Temple Place, Suite 330, Boston, MA  02111-1307  USA
//
// (C) JI1UDD 2018
//
// Meter panel TYPE1:Yado-san, TYPE2:Makino-san, TYPE3:Gyofun-san

int s_meter_type   = 0 ;            // パネルタイプ選択
int s_meter_ncolor = C16_WHITE ;    // 指針の色選択
int s_meter_needle = 0 ;            // 指針のBold選択
int tx_meter_mode  = 1 ;            // Txメーターモード選択 0:OFF, 1:ON, 2:ON(option panel)

//--------------------------------------------------------------------
// Sメーターパネルデーター
//--------------------------------------------------------------------
#define smeter_pattern_size  282
const int smeter_pattern[smeter_pattern_size]= {
0x00000000,0x00000000,0x00000000,0x00000000,0x00000000,0x00000000,// 0
0x00000000,0x00000000,0x00000000,0x00000000,0x00000000,0x00000000,// 1
0x00000000,0x00000000,0x00000000,0x00000000,0x00000000,0x00000000,// 2
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0x00000000,0x00000000,0x00000000,0x00000000,0x00000000,0x00000000 // 46
} ;

const int smeter_pattern_tx[smeter_pattern_size]= {
0x00000000,0x00000000,0x00000000,0x00000000,0x00000000,0x00000000,// 0
0x00000000,0x00000000,0x00000000,0x00000000,0x00000000,0x00000000,// 1
0x00000000,0x00000000,0x00000000,0x00000000,0x00000000,0x00000000,// 2
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0x00000000,0x00000000,0x00000000,0x00000000,0x00000000,0x00000000 // 46
} ;

#define smeter_pattern1_size  228  // = 6 * 38行
const int smeter_pattern1[smeter_pattern1_size]= {                //     Sメーターパネル TYPE1
0x00000000,0x00000000,0x00000000,0x00000000,0x00000000,0x00000000,// 0   作者：やどさん
0x00000000,0x00000000,0x00000000,0x00000000,0x00000000,0x00000000,// 1
0x00000000,0x00000000,0x00000000,0x00000000,0x00000000,0x00000000,// 2
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0x00000000,0x00000000,0x00000000,0x00000000,0x00000000,0x00000000 // 37
} ;

#define smeter_pattern2_size        216  // = 6 * 36行
#define smeter_pattern2_upper        28  // 28行
#define smeter_pattern2_upper_size (6 * smeter_pattern2_upper)
const int smeter_pattern2[smeter_pattern2_size]= {                //     Sメーターパネル TYPE2
0x00000000,0x00000000,0x00000000,0x00000000,0x00000000,0x00000000,// 0   作者：まきのさん
0x00000000,0x00000000,0x00000000,0x00000000,0x00000000,0x00000000,// 1
0x00000000,0x00000000,0x00000000,0x00000000,0x00000000,0x00000000,// 2
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0x15555555,0x55555555,0x5555555A,0xAAAAAAAA,0xAAAAAAAA,0xAAAAAAA8 // 35
} ;

#define smeter_pattern3_size  168  // = 6 * 28行
const int smeter_pattern3[smeter_pattern3_size]= {                //     Sメーターパネル TYPE3
0x00000000,0x00000000,0x00000000,0x00000000,0x00000000,0x00000000,// 0   作者：ぎょふんさん
0x00000000,0x00000000,0x00000000,0x00000000,0x00000000,0x00000000,// 1
0x00000000,0x00000000,0x00000000,0x00000000,0x00000000,0x00000000,// 2
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0x15555555,0x55555555,0x5555555A,0xAAAAAAAA,0xAAAAAAAA,0xAAAAAAA8 // 27
} ;

//--------------------------------------------------------------------
// アナログ Sメーター 指針の描画
//--------------------------------------------------------------------
#define s_meter_origin_x  270        // Sメーターの指針の原点座標
#define s_meter_origin_y   60

//------------------------------------------
// Sメーターパネル TYPE0用
//------------------------------------------
void analog_s_meter ( int s, int LLimit, int HLimit, int r1, int r2, int color ) { // s:dBu r1:外側 r2:内側
  int x0, y0, x1, y1 ;
  float cos, sin ;

  if ( s < LLimit )                   // Sメーター用 dBu値 の上下限リミット処理
    s = LLimit ;
  else if ( s > HLimit )
    s = HLimit ;

  s = (HLimit-s) * 108 / (HLimit-LLimit) + 126 ;  // LLimit(-14dBu等) は 144度、HLimit(100dBu等)は 36度に変換、更にcos_tblに合うように90度を加算
  s = (s * 512 / 180 + 1) / 2  ;     // cos_tbl引数に変換、その際に小数点1桁での丸め処理を行う    126 = 36 + 90

  cos = cos_tbl[s] ;
  sin = cos_tbl[s+128] ;
  x0 = s_meter_origin_x - (int)( sin * r1 ) ;
  y0 = s_meter_origin_y + (int)( cos * r1 ) ;
  x1 = s_meter_origin_x - (int)( sin * r2 ) ;
  y1 = s_meter_origin_y + (int)( cos * r2 ) ;
  lcd_draw_line( x0, y0, x1, y1, color ) ;
}

//------------------------------------------
// Sメーターパネル TYPE1用 (やどさん作)
//------------------------------------------
#define s_meter_type1_origin_y 24
void analog_s_meter_type1 ( int s, int s_meter_needle, int color ) {
  int x0, y0, x1, y1 ;

  if ( s < -14 )                     // Sメーター用 dBu値 の上下限リミット処理
    s = -14 ;
  else if ( s > 100 )
    s = 100 ;
                             
  s = (int)( s * 0.8158 + 236.9 ) ; // -14dBu は 225、100dBuは 318に変換
  x0 = s ;
  y0 = s_meter_type1_origin_y ;
  x1 = s ;
  y1 = s_meter_type1_origin_y + 13 ;
  lcd_draw_line( x0, y0, x1, y1, color ) ;
  if ( s_meter_needle !=0 ) lcd_draw_line( x0-1, y0, x1-1, y1, color ) ;
}

//------------------------------------------
// Sメーターパネル TYPE2用
//------------------------------------------
#define s_meter_type2_origin_y 24
void analog_s_meter_type2 ( int s, int s_meter_needle, int color ) {
  int x0, y0, x1, w0 ;

  if ( s < -14 )                    // Sメーター用 dBu値 の上下限リミット処理
    s = -14 ;
  else if ( s > 100 )
    s = 100 ;

  s = (int)( s * 0.8158 + 236.9 ) ; // -14dBu は 225、100dBuは 318に変換
  x1 = s - 224 ;                    // バーの長さ x1 = 1～94

  // バー表示に隠れない部分(16dot単位)の目盛りの描画
  int xoffset = (x1+1)/16 ;         // xoffset = 0 ～ 5
  x0 = xoffset*16 + 224 ;           // x0 = 224, 240,..., 304
  w0 = 6 - xoffset ;                // w0 = 6, 5,...1

  const int * index ;
  const int * index_base = smeter_pattern2 + xoffset ;
  for ( y0=28 ; y0<35 ; y0++ ) {
    index = index_base+(y0+1)*6 ;
    lcd_draw_pic( x0, y0, 319, y0, w0, index );
  }
  index = smeter_pattern2+35*6 ;
  lcd_draw_pic( 224, 34, 319, 34, 6, index );

  // バー表示
  x0 = 225 ;                        // xの原点 -14dBu
  y0 = s_meter_type2_origin_y + 4 ; // yの原点
  w0 = 6 ;                          // バーの幅
  lcd_draw_rectfill( x0, y0, x1, w0, color ) ;
}

//------------------------------------------
// Sメーターパネル TYPE3用 (ぎょふんさん作)
//------------------------------------------
#define s_meter_type3_origin_y 24
int bar_old = 225 ;
void analog_s_meter_type3 ( int s, int s_meter_needle, int color ) {
  int x0, y0, x1, y1 ;
  int bar_sub ;                     //前回と今回のsの差
  int bar_count ;                   //描画回数
  int bar_patn ;

  if ( s < -14 )                    // Sメーター用 dBu値 の上下限リミット処理
    s = -14 ;
  else if ( s > 100 )
    s = 100 ;

  s = (int)( s * 0.8158 + 236.9 ) ; // -14dBu は 225、100dBuは 318に変換
  y0 = s_meter_type3_origin_y + 6 ; //バーグラフの上辺
  y1 = s_meter_type3_origin_y + 11; //バーグラフの下辺
  if ( bar_old < 225 )  bar_old = 225 ;
 
  //**************************  バーグラフ表示  ***************************
  // 今回のs値と直前のs値(bar_old)が同じ場合は何もしない
  // 今回のs値が直前のs値(bar_old)より大きい場合はバーグラフを左端から描画
  if ( s > bar_old ) {
    bar_sub = s - 224 ;             //バーグラフを左端から描画
    bar_patn = (s_meter_needle == 0) ? 2 : 1 ;
    for ( bar_count = 0 ; bar_count <= bar_sub ; bar_count += bar_patn ) {
      lcd_draw_line ( 224 + 1 + bar_count, y0, 224 + 1+ bar_count, y1,  color ) ;
    }
  }

  // 今回のs値が直前のs値(bar_old)より小さい場合は差分を消去
  if ( s < bar_old ) {
    bar_sub = bar_old - s; // 差分を消去する回数　消去の起点は前回のs値(bar_old)
    for ( bar_count = 0 ; bar_count <= bar_sub ; bar_count++ ) {
      lcd_draw_line ( bar_old + 1 - bar_count, y0, bar_old + 1 - bar_count, y1, C16_BLACK ) ;
    }
  }
  bar_old = s ; // 今回のs値を直前のs値として記憶して次回比較対象とする
}


//--------------------------------------------------------------------
// Sメーターのパネルと指針の描画 (s_meter_typeでパネルタイプ指定)
//--------------------------------------------------------------------
static void disp_smeter( int s) {
LED3_ON(); // 処理時間チェック用
  switch ( s_meter_type ) {
    default:                                                                             // Sメーター TYPE0
    case 0: if ( (tx==0) || (tx_meter_mode!=2)) {                                        // 受信時または tx_meter_modeが2以外
              lcd_draw_pic( 224, 0, 319, 46, smeter_pattern_size, smeter_pattern );      // 矩形領域(224,0)-(319,46)にメーターパネルを描画
              analog_s_meter ( s, -14, 100, 48, 26, s_meter_ncolor ) ;                   // range: -14dBu(Zero) - 100dBu(FS)
            } else {
              lcd_draw_pic( 224, 0, 319, 46, smeter_pattern_size, smeter_pattern_tx );   // 送信時でtx_meter_modeが2
              analog_s_meter ( s,  65,  85, 48, 26, s_meter_ncolor ) ;                   // range:  65dBu(Zero) -  85dBu(FS)
            }
            break ;
    case 1: lcd_draw_pic( 224, 0, 319, 37, smeter_pattern1_size, smeter_pattern1);       // Sメーター TYPE1(やどさん作)
            analog_s_meter_type1( s, s_meter_needle, s_meter_ncolor  ) ;
            break ;
    case 2: lcd_draw_pic( 224, 0, 319, 27, smeter_pattern2_upper_size, smeter_pattern2); // Sメーター TYPE2(まきのさん作)
            analog_s_meter_type2( s, s_meter_needle, s_meter_ncolor  ) ;
            break ;
    case 3: lcd_draw_pic( 224, 0, 319, 27, smeter_pattern3_size, smeter_pattern3);       // Sメーター TYPE3(ぎょふんさん作)
            analog_s_meter_type3( s, s_meter_needle, s_meter_ncolor  ) ;
            break ;
  }
LED3_OFF(); // 処理時間チェック用
}
